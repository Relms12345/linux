## drivers/net/wireless/hugeic/utils/Kconfig
```kconfig
config HGIC_USB
	bool "Support USB interface"
	depends on USB && (HGICF)

config HGIC_SDIO
	bool "Support SDIO interface"
	depends on MMC && (HGICF) && !HGIC_USB

config SDIO_REINIT
	bool "Support Re-init SDIO interface"
	depends on HGIC_SDIO
```
